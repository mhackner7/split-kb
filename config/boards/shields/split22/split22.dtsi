/ {
  chosen {
    zmk,kscan = &default_kscan;
  };

  default_kscan: kscan {
    compatible = "zmk,kscan-gpio-direct";
    label = "default_kscan";

    input-gpios = 
      <&pro_micro PIN_L2 (GPIO_ACTIVE_HIGH | GPIO_PULL_DOWN)>,
      <&pro_micro PIN_L3 (GPIO_ACTIVE_HIGH | GPIO_PULL_DOWN)>,
      <&pro_micro PIN_L4 (GPIO_ACTIVE_HIGH | GPIO_PULL_DOWN)>,
      <&pro_micro PIN_L5 (GPIO_ACTIVE_HIGH | GPIO_PULL_DOWN)>,
      <&pro_micro PIN_L6 (GPIO_ACTIVE_HIGH | GPIO_PULL_DOWN)>,
      <&pro_micro PIN_L7 (GPIO_ACTIVE_HIGH | GPIO_PULL_DOWN)>,
      <&pro_micro PIN_L8 (GPIO_ACTIVE_HIGH | GPIO_PULL_DOWN)>,
      <&pro_micro PIN_L9 (GPIO_ACTIVE_HIGH | GPIO_PULL_DOWN)>,
      <&pro_micro PIN_L10 (GPIO_ACTIVE_HIGH | GPIO_PULL_DOWN)>,
      <&pro_micro PIN_L14 (GPIO_ACTIVE_HIGH | GPIO_PULL_DOWN)>,
      <&pro_micro PIN_L16 (GPIO_ACTIVE_HIGH | GPIO_PULL_DOWN)>
      
      <&pro_micro PIN_R2 (GPIO_ACTIVE_HIGH | GPIO_PULL_DOWN)>,
      <&pro_micro PIN_R3 (GPIO_ACTIVE_HIGH | GPIO_PULL_DOWN)>,
      <&pro_micro PIN_R4 (GPIO_ACTIVE_HIGH | GPIO_PULL_DOWN)>,
      <&pro_micro PIN_R5 (GPIO_ACTIVE_HIGH | GPIO_PULL_DOWN)>,
      <&pro_micro PIN_R6 (GPIO_ACTIVE_HIGH | GPIO_PULL_DOWN)>,
      <&pro_micro PIN_R7 (GPIO_ACTIVE_HIGH | GPIO_PULL_DOWN)>,
      <&pro_micro PIN_R8 (GPIO_ACTIVE_HIGH | GPIO_PULL_DOWN)>,
      <&pro_micro PIN_R9 (GPIO_ACTIVE_HIGH | GPIO_PULL_DOWN)>,
      <&pro_micro PIN_R10 (GPIO_ACTIVE_HIGH | GPIO_PULL_DOWN)>,
      <&pro_micro PIN_R14 (GPIO_ACTIVE_HIGH | GPIO_PULL_DOWN)>,
      <&pro_micro PIN_R16 (GPIO_ACTIVE_HIGH | GPIO_PULL_DOWN)>;
  };
};

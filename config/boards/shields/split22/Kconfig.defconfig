## config/boards/shields/split22/Kconfig.defconfig
```kconfig
if SHIELD_SPLIT22_LEFT


config ZMK_KEYBOARD_NAME
    default "split22"

config ZMK_SPLIT_ROLE_CENTRAL
    default y

endif

if SHIELD_SPLIT22_LEFT || SHIELD_SPLIT22_RIGHT

config ZMK_SPLIT
    default y

endif
```

## config/boards/shields/split22/Kconfig.shield
```kconfig
config SHIELD_SPLIT22_LEFT
    def_bool $(shields_list_contains, split22_left)

config SHIELD_SPLIT22_RIGHT
    def_bool $(shields_list_contains, split22_right)
```
